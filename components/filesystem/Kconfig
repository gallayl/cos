## components/filesystem/Kconfig
```kconfig
menu "COS Filesystem Configuration"

config COS_FILESYSTEM_DISABLE_SDCARD
    bool "Disable SD card initialization"
    default n
    help
        Skip SD card initialization. Enable this when building for environments
        without SD card hardware, such as QEMU integration tests.

endmenu
```

## integration_test/test_shell_fs/sdkconfig.defaults
```kconfig
CONFIG_IDF_TARGET="esp32"
CONFIG_COS_FILESYSTEM_DISABLE_SDCARD=y
CONFIG_LWIP_ICMP=y
CONFIG_ESPTOOLPY_FLASHSIZE_4MB=y
CONFIG_PARTITION_TABLE_CUSTOM=y
CONFIG_PARTITION_TABLE_CUSTOM_FILENAME="partitions.csv"
# CONFIG_COMPILER_CXX_EXCEPTIONS is not set
# CONFIG_COMPILER_CXX_RTTI is not set
```
